## br-external/package/camilladsp/Config.in
```kconfig
config BR2_PACKAGE_CAMILLADSP
	bool "camilladsp"
	depends on BR2_USE_MMU # Rust
	select BR2_PACKAGE_ALSA_LIB
	select BR2_PACKAGE_UCODE
	help
	  CamillaDSP is a flexible audio processing engine for
	  crossovers, room correction etc. (ALSA backend, websocket
	  control, 32-bit float processing). Ships camilladsp-genconf
	  (ucode: runtime config generated from uci), the procd init
	  script and uci defaults; boards override the defaults via
	  their rootfs overlay where needed.

	  https://github.com/HEnquist/camilladsp
```

## br-external/package/inferno/Config.in
```kconfig
config BR2_PACKAGE_INFERNO
	bool "inferno"
	depends on BR2_USE_MMU # Rust
	select BR2_PACKAGE_ALSA_LIB
	help
	  Unofficial implementation of the Dante protocol (Audio over IP).
	  Binaries: inferno2pipe; ALSA plugin: alsa_pcm_inferno. Ships the
	  uci defaults (/etc/config/inferno); boards override them via
	  their rootfs overlay where needed.

	  https://github.com/teodly/inferno
```

## br-external/package/jsonfilter/Config.in
```kconfig
config BR2_PACKAGE_JSONFILTER
	bool "jsonfilter"
	depends on BR2_USE_MMU # json-c
	select BR2_PACKAGE_JSON_C
	select BR2_PACKAGE_LIBUBOX
	help
	  OpenWrt JSON filter utility (jsonpath). Required by rc.common
	  (service status), lib/functions/procd.sh and lib/functions/network.sh
	  (network_get_* helpers used by ifup/ifstatus).

	  https://github.com/openwrt/jsonpath
```

## br-external/package/netifd/Config.in
```kconfig
config BR2_PACKAGE_NETIFD
	bool "netifd"
	depends on BR2_USE_MMU # fork
	select BR2_PACKAGE_LIBUBOX
	select BR2_PACKAGE_UBUS
	select BR2_PACKAGE_UCI
	select BR2_PACKAGE_JSON_C
	select BR2_PACKAGE_LIBNL
	select BR2_PACKAGE_UCODE
	select BR2_PACKAGE_UDEBUG
	help
	  OpenWrt network interface daemon. Scope limited to static IP +
	  DHCP client (udhcpc from busybox); other protos are not installed.

	  https://git.openwrt.org/?p=project/netifd.git
```

## br-external/package/procd/Config.in
```kconfig
config BR2_PACKAGE_PROCD
	bool "procd"
	depends on BR2_USE_MMU # fork
	select BR2_PACKAGE_LIBUBOX
	select BR2_PACKAGE_UBUS
	select BR2_PACKAGE_UCI
	select BR2_PACKAGE_UDEBUG
	help
	  OpenWrt init daemon (PID 1) with service supervision and hotplug.

	  https://git.openwrt.org/?p=project/procd.git
```

## br-external/package/statime/Config.in
```kconfig
config BR2_PACKAGE_STATIME
	bool "statime (inferno-dev fork)"
	depends on BR2_USE_MMU # Rust
	select BR2_PACKAGE_UCODE
	help
	  PTP daemon (fork with PTPv1 / inferno support), required by inferno.
	  Pinned commit from the inferno-dev branch. Ships ptp-monitor
	  (ucode: bridges the usrvclock export to ubus and procd hotplug),
	  the procd init scripts and uci defaults; boards override the
	  defaults via their rootfs overlay where needed.

	  https://github.com/teodly/statime (fork of pendulum-project/statime)
```

## br-external/package/ubox/Config.in
```kconfig
config BR2_PACKAGE_UBOX
	bool "ubox"
	depends on BR2_USE_MMU # fork
	select BR2_PACKAGE_LIBUBOX
	select BR2_PACKAGE_UCI
	help
	  OpenWrt small system toolbox. This build ships:
	   - kmodloader: the kernel module loader procd's init invokes on
	     /etc/modules-boot.d before preinit (dependency-aware, supports
	     'm:' deferred and 'b:' blocklist entries)
	   - validate_data + libvalidate: config validation helper used by
	     uci_validate_section() in lib/functions/procd.sh
	  Extra tools (logd/logread/lsbloader/getrandom) are disabled.

	  https://github.com/openwrt/ubox
```

## br-external/package/uci/Config.in
```kconfig
config BR2_PACKAGE_UCI
	bool "uci"
	depends on BR2_USE_MMU # fork
	select BR2_PACKAGE_LIBUBOX
	help
	  OpenWrt Unified Configuration Interface.

	  https://git.openwrt.org/?p=project/uci.git
```

## br-external/package/ucode/Config.in
```kconfig
config BR2_PACKAGE_UCODE
	bool "ucode"
	depends on BR2_USE_MMU # fork
	select BR2_PACKAGE_LIBUBOX
	select BR2_PACKAGE_LIBJSON_C
	select BR2_PACKAGE_ZLIB
	help
	  Tiny scripting language VM, required by netifd for its ucode
	  protocol handlers. Pinned to OpenWrt 25.12.5 (8592205).

	  https://github.com/jow-/ucode
```

## br-external/package/udebug/Config.in
```kconfig
config BR2_PACKAGE_UDEBUG
	bool "udebug"
	depends on BR2_USE_MMU # fork
	select BR2_PACKAGE_LIBUBOX
	select BR2_PACKAGE_UBUS
	select BR2_PACKAGE_UCODE
	help
	  OpenWrt debug library (libudebug) used by procd and netifd
	  for tracing. Pinned to OpenWrt 25.12.5 (875e1a7).

	  https://git.openwrt.org/project/udebug.git
```

## br-external/package/virgilio-base/Config.in
```kconfig
config BR2_PACKAGE_VIRGILIO_BASE
	bool "virgilio-base"
	depends on BR2_USE_MMU # procd/netifd fork()
	select BR2_PACKAGE_LIBUBOX
	select BR2_PACKAGE_UBUS
	select BR2_PACKAGE_UCI
	select BR2_PACKAGE_PROCD
	select BR2_PACKAGE_UBOX
	select BR2_PACKAGE_NETIFD
	select BR2_PACKAGE_JSONFILTER
	help
	  Generic base system shared by every Virgilio device (the OpenWrt
	  "base-files" role), independent of board, SoC and application
	  packages:

	   - procd init scripts + rc.d layout (boot, network, system, ...)
	   - /etc/config/system default
	   - system glue: lib/functions*.sh, rc.common, ifup/ifdown/ifstatus,
	     service, hotplug-call, login.sh, inittab, preinit
	   - profile, motd, hotplug dispatch config

	  Application service wiring (init scripts, uci defaults, tools)
	  ships with the app packages: camilladsp-genconf + init/config in
	  camilladsp, ptp-monitor + init/config in statime, uci defaults in
	  inferno. Their uci defaults are overridable per device via the
	  board rootfs overlay (applied after all packages).

	  Selects the uci/procd stack it requires (procd pulls ubus and
	  udebug, netifd pulls json-c/libnl/ucode). Device-specific files
	  (network topology, ALSA config, FIR coefficients, board fixups,
	  test-rig services) stay in the per-board rootfs overlay.
```

## br-external/package/virgilio-dropbear/Config.in
```kconfig
config BR2_PACKAGE_VIRGILIO_DROPBEAR
	bool "virgilio-dropbear (ssh access)"
	select BR2_PACKAGE_DROPBEAR
	help
	  Procd init + uci config for the dropbear ssh server, shared by
	  every board that ships ssh access (the per-board copies were
	  byte-identical). uci /etc/config/dropbear option enable (1/0) is
	  the web UI System > Settings toggle; missing config means enabled.
	  Keys are persistent (real /etc/dropbear, not Buildroot's volatile
	  /var/run symlink; the init removes the dangling link).
```

## br-external/package/virgilio-mpd/Config.in
```kconfig
config BR2_PACKAGE_VIRGILIO_MPD
	bool "virgilio-mpd (web-radio / media source)"
	depends on BR2_USE_MMU
	select BR2_PACKAGE_MPD
	select BR2_PACKAGE_MPD_MPC
	select BR2_PACKAGE_MPD_ALSA
	select BR2_PACKAGE_MPD_CURL
	select BR2_PACKAGE_MPD_MAD
	select BR2_PACKAGE_MPD_FAAD2
	select BR2_PACKAGE_MPD_VORBIS
	select BR2_PACKAGE_MPD_OPUS
	select BR2_PACKAGE_MPD_FLAC
	select BR2_PACKAGE_MPD_ID3TAG
	select BR2_PACKAGE_MPD_LIBSNDFILE
	# https streams: TLS backend + CA bundle for libcurl (mbedtls gets no
	# trust store in Buildroot's liburl.mk; OpenSSL does)
	select BR2_PACKAGE_OPENSSL
	select BR2_PACKAGE_LIBCURL_OPENSSL
	select BR2_PACKAGE_CA_CERTIFICATES
	help
	  MPD as the web-radio/media source feeding the Dante transmitter
	  (mpd.conf -> snd-aloop loopplay; playback is consumed downstream
	  via loopcap). Ships the procd init + mpd.conf with data under
	  /opt/user_data/mpd (user content, nothing preloaded). Autostart is
	  a per-board rc.d choice: this package installs only the K30 stop
	  link; a board that wants MPD at boot adds an S96mpd rc.d symlink
	  plus the etc/virgilio/flags/keep-mpd marker (see the srcqemu board).
```

## br-external/package/webui/Config.in
```kconfig
config BR2_PACKAGE_WEBUI
	bool "webui"
	depends on BR2_USE_MMU # ucode
	select BR2_PACKAGE_UCODE
	select BR2_PACKAGE_NGINX
	select BR2_PACKAGE_NGINX_HTTP_SCGI_MODULE
	select BR2_PACKAGE_NGINX_HTTP_AUTH_REQUEST_MODULE
	select BR2_PACKAGE_NGINX_HTTP_GZIP_STATIC_MODULE
	select BR2_PACKAGE_NGINX_HTTP_SSL_MODULE
	help
	  Minimal appliance web UI: nginx front (static SPA, auth-gated
	  websocket proxy to camilladsp) + webuid, a ucode daemon speaking
	  SCGI and implementing the OUI-style JSON RPC contract with
	  /etc/shadow login (plan/webui.md).

	  The login app is always installed (part of the auth shell). Pick
	  the feature apps below per device; each one declares the service
	  packages it needs.

	  https://github.com/../../plan/webui.md

config BR2_PACKAGE_WEBUI_APP_HOME
	bool "home app (LAN dashboard)"
	depends on BR2_PACKAGE_WEBUI
	select BR2_PACKAGE_NETIFD
	help
	  Landing dashboard after login: LAN address, audio chain status.
	  Reads interface state over ubus (netifd).

config BR2_PACKAGE_WEBUI_APP_STATUS
	bool "status app (system overview)"
	depends on BR2_PACKAGE_WEBUI
	help
	  System info overview (kernel, uptime, load). Shows the DSP state
	  when the camilladsp ubus object exists; degrades gracefully
	  without camilladsp.

config BR2_PACKAGE_WEBUI_APP_SYSTEM
	bool "system app (settings, password, maintenance)"
	depends on BR2_PACKAGE_WEBUI
	help
	  System settings, password change, maintenance/factory reset.

config BR2_PACKAGE_WEBUI_APP_NETSTAT
	bool "netstat app (interface statistics)"
	depends on BR2_PACKAGE_WEBUI
	select BR2_PACKAGE_NETIFD
	help
	  Per-interface packet/rate counters (/proc/net + ubus netifd).

config BR2_PACKAGE_WEBUI_APP_NETWORK
	bool "network app (interface configuration)"
	depends on BR2_PACKAGE_WEBUI
	select BR2_PACKAGE_NETIFD
	help
	  View/edit /etc/config/network through the uci RPC bridge.

config BR2_PACKAGE_WEBUI_APP_LOGS
	bool "logs app (system log viewer)"
	depends on BR2_PACKAGE_WEBUI
	select BR2_PACKAGE_UBOX
	help
	  Kernel/system log viewer; reads the ring buffer via logread
	  (shipped by ubox).

config BR2_PACKAGE_WEBUI_APP_DSP
	bool "dsp apps (profile/filter editors)"
	depends on BR2_PACKAGE_WEBUI
	select BR2_PACKAGE_CAMILLADSP
	help
	  DSP profile and filter editor pages. Requires camilladsp:
	  pipeline RPCs run camilladsp-genconf dry-runs and the live EQ
	  view proxies to the camilladsp websocket (nginx location /_dsp,
	  port 5000).

config BR2_PACKAGE_WEBUI_APP_INFERNO
	bool "inferno app (Dante/AoIP node status)"
	depends on BR2_PACKAGE_WEBUI
	select BR2_PACKAGE_INFERNO
	select BR2_PACKAGE_CAMILLADSP
	help
	  Inferno (Dante over IP) node status: subscriptions, flows and
	  clock state; shares the DSP pipeline RPCs for the audio path.
```
